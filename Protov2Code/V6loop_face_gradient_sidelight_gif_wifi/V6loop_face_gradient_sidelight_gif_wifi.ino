#include <WiFi.h>
#include <WebServer.h>
#include <AnimatedGIF.h>
#include <BLEDevice.h>
#include <BLEServer.h>
#include <BLEUtils.h>
#include <BLE2902.h>
#include <Adafruit_Protomatter.h> // For RGB matrix
#include <cstdint>
#include <cmath>
#include <SD.h>
#include <SPI.h>
#include <Adafruit_NeoPixel.h>
#include <pgmspace.h>





//// Side Light Stuff
#define NEOPIX_PIN       A0      // Signal pin is A0
#define NEOPIX_NUMPIXELS 24      // 24 LEDs on your ring
const int NEOPIX_NUMPIXELS2 = (int)(NEOPIX_NUMPIXELS/2);
#define NEOPIX_BRIGHTNESS 200     // value between 0 and 255 
#define NUM_STEPS_SIDE_ITER 2    // Number of timesteps to wait for each iteration
int SIDE_INCREMENT_VALUE = 1;        // Value to increment each NUM_STEPS_SIDE_ITER
const bool side_iter = true;
const bool rotate = true;
const bool invert_side = false;
// Initialize side light
Adafruit_NeoPixel neopixels(NEOPIX_NUMPIXELS, NEOPIX_PIN, NEO_GRBW + NEO_KHZ800);
// Stores the RGBW timesteps
int side_light_WRGB_time[NEOPIX_NUMPIXELS];



//// MATRIX STUFF
#define HEIGHT  32 // Matrix height (pixels) - SET TO 64 FOR 64x64 MATRIX!
#define WIDTH   128 // Matrix width (pixels)
#define WIDTH2  64

// Used for face gradient
const uint8_t gradient_R1 = 156;
const uint8_t gradient_G1 = 9;
const uint8_t gradient_B1 = 185;
const uint8_t gradient_R2 = 55;
const uint8_t gradient_G2 = 249;
const uint8_t gradient_B2 = 120;

// Loop mode can either be a loop or one that reverses itself
const char* LOOP_MODE = "reversed_loop"; // Either "loop" or "reversed_loop"
int loop_addition = 1;

// Number of frames per iteration
#define NUM_FRAMES 5


// Constant unit of time for the clock in seconds
const double time_unit = 0.01;
// Constant unit of time for each frame denoting how many iterations
// between each frame in seconds.
const uint16_t frame_time_unit_ranges[NUM_FRAMES][2] = {
  {100, 400},
  {2, 2},
  {2, 2},
  {2, 2},
  {2, 2}
};
double cur_frame_time;
// Constant modes for each frame ("rainbow", "gradient", or "")
const char* frame_modes[NUM_FRAMES] {
//   "rainbow",
//   "rainbow",
//   "rainbow",
//   "rainbow",
//   "rainbow",
// };
  "",
  "",
  "",
  "",
  "",
};
// Reset screen when changing frames
bool resetScreen = false;

// // Probability of showing the random bitmap
// double random_bitmap_prob = 0.1;
// // Constant frame range in random mode
// const uint16_t random_frame_time_unit_range[2] = {200, 500};
// double cur_frame_time_random;
// // Ranodm frame mode
// bool random_frame_mode = false;
// // Cur num of iters in random frame mode
// uint16_t num_iters_random = 0;

// EMA to measure the time between loop cyles
float loop_EMA = 0.0;
float update_face_EMA = 0.0;

uint16_t t_vals[HEIGHT][WIDTH2]; // Holds the time for each pixel to form a wave
uint16_t frame_val = 0; // Holds the "time" value for the frame.
int16_t cur_frame = 0; // Holds the current frame number
uint16_t new_bitmap[HEIGHT][WIDTH2];



#define MAX_FPS 120 // Maximum redraw rate, frames/second/home/gmongaras/Documents/MyStuff/Protogen/Programming/LCD_Eye_Blink_4/LCD_Eye_Blink_4.ino
#if defined(_VARIANT_MATRIXPORTAL_M4_) // MatrixPortal M4
uint8_t rgbPins[]  = {7, 8, 9, 10, 11, 12};
uint8_t addrPins[] = {17, 18, 19, 20, 21};
uint8_t clockPin   = 14;
uint8_t latchPin   = 15;
uint8_t oePin      = 16;
#else // MatrixPortal ESP32-S3
uint8_t rgbPins[]  = {42, 41, 40, 38, 39, 37};
uint8_t addrPins[] = {45, 36, 48, 35, 21};
uint8_t clockPin   = 2;
uint8_t latchPin   = 47;
uint8_t oePin      = 14;
#endif
#if HEIGHT == 16
#define NUM_ADDR_PINS 3
#elif HEIGHT == 32
#define NUM_ADDR_PINS 4
#elif HEIGHT == 64
#define NUM_ADDR_PINS 5
#endif
Adafruit_Protomatter matrix(
  WIDTH, 4, 1, rgbPins, NUM_ADDR_PINS, addrPins,
  clockPin, latchPin, oePin, true);











#define MAX_GIF_SIZE 200000  // 200KB max GIF size (adjust to your needs & RAM)

// const char* ssid = "Protogen >w<";
// const char* password = "UwU";

// Site at 192.168.4.1

const char* ssid = "Protogen >w<";
const char* password = "";

WebServer server(80);
AnimatedGIF gif;
uint8_t* gifBuffer = nullptr;
size_t gifSize = 0;

const char upload_form[] PROGMEM = R"rawliteral(
<!DOCTYPE html><html><body>
<h2>Upload a GIF</h2>
<form method='POST' action='/upload' enctype='multipart/form-data'>
  <input type='file' name='giffile' accept='.gif'><br><br>
  <input type='submit' value='Upload GIF'>
</form>
</body></html>
)rawliteral";


uint16_t bitmaps[NUM_FRAMES][HEIGHT][WIDTH2] = {
  {	
	{0x0000,0x0000,0x0000,0x0000,0x0000,0x0000,0x0000,0x0000,0x0000,0x0000,0x0000,0x0000,0x0000,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0x0000,},
	{0x0000,0x0000,0x0000,0x0000,0x0000,0x0000,0x0000,0x0000,0x0000,0x0000,0x0000,0x0000,0x0000,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0x0000,},
	{0x0000,0x0000,0x0000,0x0000,0x0000,0x0000,0x0000,0x0000,0x0000,0x0000,0x0000,0x0000,0x0000,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0x0000,},
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	{0x0000,0x0000,0x0000,0x0000,0x0000,0x0000,0x0000,0x0000,0x0000,0x0000,0x0000,0x0000,0x0000,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0x0000,}
  },
  {	
	{0x0000,0x0000,0x0000,0x0000,0x0000,0x0000,0x0000,0x0000,0x0000,0x0000,0x0000,0x0000,0x0000,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0x0000,},
	{0x0000,0x0000,0x0000,0x0000,0x0000,0x0000,0x0000,0x0000,0x0000,0x0000,0x0000,0x0000,0x0000,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0x0000,},
	{0x0000,0x0000,0x0000,0x0000,0x0000,0x0000,0x0000,0x0000,0x0000,0x0000,0x0000,0x0000,0x0000,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0x0000,},
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	{0x0000,0x0000,0x0000,0x0000,0x0000,0x0000,0x0000,0x0000,0x0000,0x0000,0x0000,0x0000,0x0000,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0x0000,}
  },
  {	
	{0x0000,0x0000,0x0000,0x0000,0x0000,0x0000,0x0000,0x0000,0x0000,0x0000,0x0000,0x0000,0x0000,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0x0000,},
	{0x0000,0x0000,0x0000,0x0000,0x0000,0x0000,0x0000,0x0000,0x0000,0x0000,0x0000,0x0000,0x0000,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0x0000,},
	{0x0000,0x0000,0x0000,0x0000,0x0000,0x0000,0x0000,0x0000,0x0000,0x0000,0x0000,0x0000,0x0000,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0x0000,},
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	{0x0000,0x0000,0x0000,0x0000,0x0000,0x0000,0x0000,0x0000,0x0000,0x0000,0x0000,0x0000,0x0000,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0x0000,}
  },
  {	
	{0x0000,0x0000,0x0000,0x0000,0x0000,0x0000,0x0000,0x0000,0x0000,0x0000,0x0000,0x0000,0x0000,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0x0000,},
	{0x0000,0x0000,0x0000,0x0000,0x0000,0x0000,0x0000,0x0000,0x0000,0x0000,0x0000,0x0000,0x0000,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0x0000,},
	{0x0000,0x0000,0x0000,0x0000,0x0000,0x0000,0x0000,0x0000,0x0000,0x0000,0x0000,0x0000,0x0000,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0x0000,},
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	{0x0000,0x0000,0x0000,0x0000,0x0000,0x0000,0x0000,0x0000,0x0000,0x0000,0x0000,0x0000,0x0000,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0x0000,}
  },
  {	
	{0x0000,0x0000,0x0000,0x0000,0x0000,0x0000,0x0000,0x0000,0x0000,0x0000,0x0000,0x0000,0x0000,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0x0000,},
	{0x0000,0x0000,0x0000,0x0000,0x0000,0x0000,0x0000,0x0000,0x0000,0x0000,0x0000,0x0000,0x0000,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0x0000,},
	{0x0000,0x0000,0x0000,0x0000,0x0000,0x0000,0x0000,0x0000,0x0000,0x0000,0x0000,0x0000,0x0000,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0x0000,},
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	{0x0000,0x0000,0x0000,0x0000,0x0000,0x0000,0x0000,0x0000,0x0000,0x0000,0x0000,0x0000,0x0000,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0x0000,}
  }
};

uint16_t random_bitmap[HEIGHT][WIDTH2] = {
  {0x0000,0x0000,0x0000,0x0000,0x0000,0x0000,0x0000,0x0000,0x0000,0x0000,0x0000,0x0000,0x0000,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0x0000,},
  {0x0000,0x0000,0x0000,0x0000,0x0000,0x0000,0x0000,0x0000,0x0000,0x0000,0x0000,0x0000,0x0000,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0x0000,},
  {0x0000,0x0000,0x0000,0x0000,0x0000,0x0000,0x0000,0x0000,0x0000,0x0000,0x0000,0x0000,0x0000,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0x0000,},
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  {0x0000,0x0000,0x0000,0x0000,0x0000,0x0000,0x0000,0x0000,0x0000,0x0000,0x0000,0x0000,0x0000,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0x0000,}
};



// Helper: Convert RGB888 to RGB565
uint16_t rgb888_to_rgb565(uint8_t r, uint8_t g, uint8_t b) {
    uint16_t r5 = (r >> 3) & 0x1F;
    uint16_t g6 = (g >> 2) & 0x3F;
    uint16_t b5 = (b >> 3) & 0x1F;
    return (r5 << 11) | (b5 << 6) | g6;
}

// Helper: HSV to RGB conversion
template <typename int_type>
void hsv_to_rgb(float h, float s, float v, int_type& r, int_type& g, int_type& b) {
    float c = v * s;
    float x = c * (1 - std::fabs(fmod(h * 6, 2) - 1));
    float m = v - c;

    float r_, g_, b_;
    if (h < 1.0 / 6) {
        r_ = c; g_ = x; b_ = 0;
    } else if (h < 2.0 / 6) {
        r_ = x; g_ = c; b_ = 0;
    } else if (h < 3.0 / 6) {
        r_ = 0; g_ = c; b_ = x;
    } else if (h < 4.0 / 6) {
        r_ = 0; g_ = x; b_ = c;
    } else if (h < 5.0 / 6) {
        r_ = x; g_ = 0; b_ = c;
    } else {
        r_ = c; g_ = 0; b_ = x;
    }

    r = static_cast<int_type>((r_ + m) * 255);
    g = static_cast<int_type>((g_ + m) * 255);
    b = static_cast<int_type>((b_ + m) * 255);
}

// Compute rainbow color and return RGB565
uint16_t rainbow_rgb565(int t, int max_) {
    if (t < 0 || t > max_) return 0;

    float hue = static_cast<float>(t) / max_;  // hue ∈ [0, 1]
    uint8_t r, g, b;
    hsv_to_rgb<uint8_t>(hue, 1.0f, 1.0f, r, g, b);
    return rgb888_to_rgb565(r, g, b);
}

uint16_t rainbow_rgb565_flipgb(int t, int max_) {
    if (t < 0 || t > max_) return 0;

    float hue = static_cast<float>(t) / max_;  // hue ∈ [0, 1]
    uint8_t r, g, b;
    hsv_to_rgb<uint8_t>(hue, 1.0f, 1.0f, r, g, b);
    return rgb888_to_rgb565(r, b, g);
}

uint16_t gradient_rgb565(int t, int max_, 
                         uint8_t r1, uint8_t g1, uint8_t b1, 
                         uint8_t r2, uint8_t g2, uint8_t b2) {
    if (t < 0 || t > max_) return 0;

    float alpha = static_cast<float>(t) / max_;  // alpha ∈ [0, 1]

    uint8_t r = static_cast<uint8_t>((1 - alpha) * r1 + alpha * r2);
    uint8_t g = static_cast<uint8_t>((1 - alpha) * g1 + alpha * g2);
    uint8_t b = static_cast<uint8_t>((1 - alpha) * b1 + alpha * b2);

    return rgb888_to_rgb565(r, g, b);
}

void assert_or_halt(bool condition, const char* message = "") {
  if (!condition) {
    Serial.println("Assertion failed!");
    if (message[0] != '\0') {
      Serial.println(message);
    }
    while (true); // Infinite loop: halts execution
  }
}

// used to turn a timestep into a WBGR value
uint32_t rainbow_WRGB(int t, int max_) {
    // For some reason, putting these here fixes problems with the sides?
    // If the serial monitor is on, this breaks and the sides flash
    // I don't know why, but it's """fixed""" so whatever.
    assert_or_halt(max_ > 0, "max_ must be > 0");
    assert_or_halt(t >= 0 && t <= max_, "t out of range");

    float hue = static_cast<float>(t) / max_;  // hue ∈ [0, 1]
    uint32_t r, g, b;
    hsv_to_rgb<uint32_t>(hue, 1.0f, 1.0f, r, g, b);

    // Convert to WBGR
    return 0x00000000 | (r << 16) | (g << 8) | b;
}

void drawPixel(int y, int x, uint16_t pixval) {
  matrix.drawPixel(WIDTH2-x, HEIGHT-y-1, pixval);
  matrix.drawPixel(WIDTH2+x, HEIGHT-y-1, pixval);
}

// Generate the rainbow bitmap
void generate_bitmap(uint16_t t_vals[HEIGHT][WIDTH2], bool increment=false) {
    for (int y = 0; y < HEIGHT; ++y) {
        for (int x = 0; x < WIDTH2; ++x) {
            // Increment t values
            if (increment) {
              t_vals[y][x] = (t_vals[y][x] - 1) % WIDTH2;
            }
            // Only put pixels on the reference image
            if (bitmaps[cur_frame][y][x] == 0x0) {
              if (resetScreen){
                drawPixel(y, x, 0x0);
              }
              continue;
            }
            // Change bitmap
            uint16_t pixval;
            if (frame_modes[cur_frame] == "gradient") {
              pixval = gradient_rgb565(t_vals[y][x], WIDTH2, gradient_R1, gradient_G1, gradient_B1, gradient_R2, gradient_G2, gradient_B2);
            } else if (frame_modes[cur_frame] == "rainbow") {
              pixval = rainbow_rgb565_flipgb(t_vals[y][x], WIDTH2);
            } else {
              pixval = bitmaps[cur_frame][y][x];
            }
            drawPixel(y, x, pixval);
        }
    }
}

// t values initialization
void get_t_vals_init(uint16_t t_vals[HEIGHT][WIDTH2]) {
  for (int y = 0; y < HEIGHT; ++y) {
        for (int x = 0; x < WIDTH2; ++x) {
            int t = x;
            t_vals[y][x] = t;
        }
    }
}





// Function to initialize the matrix from a bitmap
void initMatrixFromBitmap(bool initialize_pix) {
  // Update the matrix screen with pixels
  for (int y = 0; y < HEIGHT; y++) {
    for (int x = 0; x < WIDTH2; x++) {
      // Write the pixel to the matrix
      drawPixel(y, x, bitmaps[0][y][x]);
    }
  }
  matrix.show(); // Display the bitmap on the matrix
}



// Used to get a random time given a range array
long getRandomNumber(const uint16_t range_[2]) {
  if (range_[0] == range_[1]) {
    return range_[0];
  }
  return random(range_[0], range_[1]);
}




File gifFile;

unsigned long height_skip_factor;
unsigned long width_skip_factor;

#include "bk.h"
uint16_t frame_buffer[HEIGHT][WIDTH2];

// Generate the rainbow bitmap
// bitmap - the bitmap to draw
// t_vals - time values for each pixel
// increment - True to increment the t_vals. False to not
void draw_bitmap(uint16_t bitmap[HEIGHT][WIDTH2], uint16_t t_vals[HEIGHT][WIDTH2], bool increment=false) {
    for (int y = 0; y < HEIGHT; ++y) {
        for (int x = 0; x < WIDTH2; ++x) {
            // Increment t values
            if (increment) {
              t_vals[y][x] = (t_vals[y][x] - 1) % WIDTH2;
            }
            // Only put pixels on the reference image
            if (bitmap[y][x] == 0x0) {
              if (resetScreen){
                drawPixel(y, x, 0x0);
              }
              continue;
            }
            // Change bitmap
            uint16_t pixval;
            if (frame_modes[0] == "gradient") {
              pixval = gradient_rgb565(t_vals[y][x], WIDTH2, gradient_R1, gradient_G1, gradient_B1, gradient_R2, gradient_G2, gradient_B2);
            } else if (frame_modes[0] == "rainbow") {
              pixval = rainbow_rgb565_flipgb(t_vals[y][x], WIDTH2);
            } else {
              pixval = bitmap[y][x];
            }
            drawPixel(y, x, pixval);
        }
    }
}


void drawLine(GIFDRAW *pDraw) {
  uint16_t *d, *usPalette, usTemp[320];
  int x, y, iWidth;

  usPalette = pDraw->pPalette;
  y = pDraw->iY + pDraw->y; // current line

  if (y < 0 || y >= HEIGHT*height_skip_factor) return; // Skip safety
  if (y % height_skip_factor != 0) return;

  y = y / height_skip_factor;

  uint8_t *s = pDraw->pPixels;
  // uint16_t *palette = pDraw->pPalette;

  Serial.printf("width: %d, height: %d, %d, %d\n", pDraw->iWidth, pDraw->iHeight, pDraw->iX, pDraw->iY);

  for (int x = 0; x < pDraw->iWidth && x < WIDTH2; x++) {
    // uint16_t val = s[x*15*2];
    uint8_t colorIndex = s[x*width_skip_factor];
    uint16_t color = usPalette[colorIndex]; // Convert index to RGB565 color
    // frame_buffer[y][x] = val;
    // uint8_t r = (val >> 11) & 0x1F;
    // uint8_t g = (val >> 5) & 0x3F;
    // uint8_t b = val & 0x1F;
    // // Optionally scale to 8-bit if needed:
    // r = (r << 3) | (r >> 2);
    // g = (g << 2) | (g >> 4);
    // b = (b << 3) | (b >> 2);
    frame_buffer[y][x+pDraw->iX] = color;
    // frame_buffer[y][x] = 0x00000000 | (r << 16) | (g << 8) | b; //(r >> 3) << 11 | (g >> 2) << 5 | (b >> 3);
  }

  // s = s[x];

}

void setup() {
  Serial.begin(921600);

  WiFi.softAP(ssid, password);
  Serial.println(WiFi.softAPIP());

  // Initialize the matrix
  ProtomatterStatus status = matrix.begin();

  gif.begin(LITTLE_ENDIAN_PIXELS);

  // Allocate memory buffer for GIF
  gifBuffer = (uint8_t*)malloc(MAX_GIF_SIZE);
  if (!gifBuffer) {
    Serial.println("Failed to allocate gifBuffer");
    while (true);  // Stop here if no memory
  }

  // Root page
  server.on("/", HTTP_GET, []() {
    server.send_P(200, "text/html", upload_form);
  });

  // Upload handler
  server.on("/upload", HTTP_POST, []() {
    server.send(200, "text/html", "<h2>Upload successful</h2><a href='/'>Back</a>");
  }, handleUpload);

  server.begin();
}

unsigned long startTime;
unsigned long endTime;
double elapsedTime;
unsigned long num_steps_side = 0;

void resetFrameBuffer() {
  for (int h = 0; h < HEIGHT; h++) {
    for (int w = 0; w < WIDTH2; w++) {
      drawPixel(h, w, 0);
    }
  }
}

void loop() {
  server.handleClient();

  Serial.printf("Loop gif size: %d bytes\n", gifSize);

  if (gifSize > 0) {
    bool success = gif.open(gifBuffer, gifSize, drawLine);
    if (!success) {
      Serial.println("[ERROR] Failed to open GIF");

      // Optional: check possible reasons
      if (gifSize < 6) {
        Serial.println("[HINT] File too small to be a valid GIF");
      } else if (gifBuffer[0] != 'G' || gifBuffer[1] != 'I' || gifBuffer[2] != 'F') {
        Serial.println("[HINT] Missing GIF signature (not a valid GIF file)");
      } else {
        Serial.printf("[DEBUG] First 6 bytes: %c%c%c %c%c%c\n",
          gifBuffer[0], gifBuffer[1], gifBuffer[2],
          gifBuffer[3], gifBuffer[4], gifBuffer[5]);
      }

      Serial.print("Last 4 bytes: ");
      for (int i = gifSize - 4; i < gifSize; i++) {
        Serial.printf("%02X ", gifBuffer[i]);
      }
      Serial.println();
    }

    // Only play if GIF has been uploaded
    else {
      Serial.println("Playing uploaded GIF from RAM");
      Serial.printf("Successfully opened GIF; Canvas size = %d x %d\n", gif.getCanvasWidth(), gif.getCanvasHeight());

      // while (gif.playFrame(true, NULL)) {
      //   draw_bitmap();  // Replace with your LED display function
      // }

      // We want to reset the screen with zeros
      resetScreen = true;

      // Reset the frame buffer
      resetFrameBuffer();
      draw_bitmap(frame_buffer, t_vals);
      matrix.show();

      // Get height and width skip factor
      height_skip_factor = max((int)floor((float)gif.getCanvasHeight() / (float)HEIGHT), 1);
      width_skip_factor = max((int)floor((float)gif.getCanvasWidth() / (float)WIDTH2), 1);

      Serial.printf("Successfully opened GIF; skip sizes: skip_width = %d, skip_height %d\n", width_skip_factor, height_skip_factor);

      // Play all frames of the gif
      int delay_ = 1000;
      while (gif.playFrame(false, &delay_)) {
        resetFrameBuffer();
        draw_bitmap(frame_buffer, t_vals);
        matrix.show();

        // delay(1000);
      }
      draw_bitmap(frame_buffer, t_vals);
      matrix.show();
      gif.close();


      delay(10);  // Delay before replay


      // Reset the frame buffer
      resetFrameBuffer();
      draw_bitmap(frame_buffer, t_vals);
      matrix.show();

      exit(0);
    }
  } 
}

// Handle uploaded GIF to memory buffer
void handleUpload() {
  HTTPUpload& upload = server.upload();

  static size_t offset = 0;

  if (upload.status == UPLOAD_FILE_START) {
    Serial.printf("Uploading: %s\n", upload.filename.c_str());
    offset = 0;
  } else if (upload.status == UPLOAD_FILE_WRITE) {
    if (offset + upload.currentSize > MAX_GIF_SIZE) {
      Serial.println("Upload too large! Resize to width of 64 and height of 32 at https://ezgif.com/resize");
      return;
    }

    memcpy(gifBuffer + offset, upload.buf, upload.currentSize);
    offset += upload.currentSize;
  } else if (upload.status == UPLOAD_FILE_END) {
    gifSize = offset;
    Serial.printf("Upload complete. Total size: %d bytes\n", gifSize);
  }
}

