#include <Wire.h>                 // For I2C communication
#include <Adafruit_LIS3DH.h>      // For accelerometer
#include <Adafruit_PixelDust.h>   // For sand simulation
#include <Adafruit_Protomatter.h> // For RGB matrix

Adafruit_LIS3DH accel_bk = Adafruit_LIS3DH();

// Pointer to a sand object
Adafruit_PixelDust* sand_bk = nullptr;
Adafruit_PixelDust* sand2_bk = nullptr;

// Number of grains in the sand object
int N_GRAINS_bk = 0;
int N_GRAINS2_bk = 0;

// pair of vectors for all nonzero pixels
std::pair<std::vector<std::pair<int, int>>, std::vector<uint16_t>> nonzero_pix_bk = {
    {},  // Empty vector of pairs<int, int> (coordinates)
    {}   // Empty vector of uint16_t (pixel value)
};
std::pair<std::vector<std::pair<int, int>>, std::vector<uint16_t>> nonzero_pix2_bk = {
    {},  // Empty vector of pairs<int, int> (coordinates)
    {}   // Empty vector of uint16_t (pixel value)
};

uint32_t prevTime = 0; // Used for frames-per-second throttle

// SETUP - RUNS ONCE AT PROGRAM START --------------------------------------

void err(int x) {
  uint8_t i;
  pinMode(LED_BUILTIN, OUTPUT);       // Using onboard LED
  for(i=1;;i++) {                     // Loop forever...
    digitalWrite(LED_BUILTIN, i & 1); // LED on/off blink to alert user
    delay(x);
  }
}

// Example 64x32 bitmap in RGB565 format (use your own bitmap data here)
// Each entry corresponds to a pixel color in RGB565 format
uint16_t bitmap_bk[32][64] = {
  { 0x0000, 0x0000, 0x0000, 0x0000, 0x0000, 0x0000, 0x0000, 0x0000, 0x0000, 0x0000, 0x0000, 0x0000, 0x0000,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 0x0000, 0x0000 },
  { 0x0000, 0x0000, 0x0000, 0x0000, 0x0000, 0x10A2, 0x5ACB, 0x0000, 0x0000, 0x0000, 0x0000, 0x0000, 0x0000,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 0x0000, 0x0000 },
  { 0x0000, 0x0000, 0x0000, 0x0000, 0x0000, 0x52AA, 0xFFFF, 0x738E, 0x0000, 0x0000, 0x0000, 0x0000, 0x0000,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 0x0000, 0x0000 },
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  { 0x0000, 0x0000, 0x0000, 0x0000, 0x0000, 0x0000, 0x0000, 0x0000, 0x0000, 0x0000, 0x0000, 0x9492, 0xFFFF,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 0x0000, 0x0000 }
};

// // Function to initialize the matrix from a bitmap
// void initMatrixFromBitmap(uint16_t bitmap[HEIGHT][WIDTH2], bool initialize_pix) {
//   // Update the matrix screen with pixels
//   for (int y = 0; y < HEIGHT; y++) {
//     for (int x = 0; x < WIDTH2; x++) {
//       // Write the pixel to the matrix
//       uint16_t pixval = bitmap[y][x];
//       matrix.drawPixel(WIDTH2-x-1, HEIGHT-y, pixval);
//       matrix.drawPixel(2*WIDTH2-x-1, HEIGHT-y, pixval);

//       // Get all x, y, and pixel values for nonzero pixels in the bitmap
//       if (initialize_pix) {
//         if ((uint16_t)pixval != (uint16_t)0x000) {
//           nonzero_pix_bk.first.push_back(std::make_pair(WIDTH2-x-1, HEIGHT-y));
//           nonzero_pix2_bk.first.push_back(std::make_pair(WIDTH2-x-1, HEIGHT-y));
//           nonzero_pix_bk.second.push_back(pixval);
//           nonzero_pix2_bk.second.push_back(pixval);
//         }
//       }
//     }
//   }
//   matrix.show(); // Display the bitmap on the matrix
// }



// Function to initialize the matrix from a bitmap
void initMatrixFromBitmap(uint16_t bitmap[HEIGHT][WIDTH2], bool initialize_pix) {
  // Update the matrix screen with pixels
  for (int y = 0; y < HEIGHT; y++) {
    for (int x = 0; x < WIDTH2; x++) {
      // Write the pixel to the matrix
      uint16_t pixval = bitmap[y][x];
      // matrix.drawPixel(WIDTH2-x-1, HEIGHT-y, pixval);
      // matrix.drawPixel(2*WIDTH2-x-1, HEIGHT-y, pixval);
      matrix.drawPixel(WIDTH2-x-1, HEIGHT-y, pixval);
      matrix.drawPixel(WIDTH2+x, HEIGHT-y, pixval);

      // Get all x, y, and pixel values for nonzero pixels in the bitmap
      if (initialize_pix) {
        if ((uint16_t)pixval != (uint16_t)0x000) {
          nonzero_pix_bk.first.push_back(std::make_pair(WIDTH2-x-1, HEIGHT-y));
          nonzero_pix2_bk.first.push_back(std::make_pair(WIDTH2-x-1, HEIGHT-y));
          nonzero_pix_bk.second.push_back(pixval);
          nonzero_pix2_bk.second.push_back(pixval);
        }
      }
    }
  }
  matrix.show(); // Display the bitmap on the matrix
}

void setup_falling_sand_bk(void) {
  // Reset variables
  if (sand_bk == nullptr) {
    delete sand_bk;
    sand_bk = nullptr;
  }
  if (sand2_bk == nullptr) {
    delete sand2_bk;
    sand2_bk = nullptr;
  }
  N_GRAINS_bk = 0;
  N_GRAINS2_bk = 0;
  if (nonzero_pix_bk.first.size() > 0) {
    nonzero_pix_bk = { {}, {} };
  }
  if (nonzero_pix2_bk.first.size() > 0) {
    nonzero_pix2_bk = { {}, {} };
  }


  // Initialize the matrix with a bitmap and get the nonzero grains
  initMatrixFromBitmap(bitmap_bk, true);

  // Get number of nonzero grains
  N_GRAINS_bk = nonzero_pix_bk.first.size();
  N_GRAINS2_bk = nonzero_pix2_bk.first.size();

  // other params
  int s = 1; // Accelerometer scaling
  int e = 32; // Particle elasticity/bounce
  // Create the sand object for each screen
  sand_bk = new Adafruit_PixelDust(WIDTH2, HEIGHT, N_GRAINS_bk, s, e, false);
  sand2_bk = new Adafruit_PixelDust(WIDTH2, HEIGHT, N_GRAINS2_bk, s, e, false);

  // Start sand and accelerometer
  if (!sand_bk->begin()) {
    Serial.println("Couldn't start sand");
    err(1000); // Slow blink = malloc error
  }
  if (!sand2_bk->begin()) {
    Serial.println("Couldn't start sand");
    err(1000); // Slow blink = malloc error
  }
  if (!accel_bk.begin(0x19)) {
    Serial.println("Couldn't find accelerometer");
    err(250);  // Fast blink = I2C error
  }
  accel_bk.setRange(LIS3DH_RANGE_2_G);   // 2, 4, 8 or 16 G! - The higher the more sticky the sand

  // Iterate over all grains and set them in the sand object
  for (size_t i = 0; i < N_GRAINS_bk; ++i) {
    // Get x, y values from the first vector
    int x = nonzero_pix_bk.first[i].first;
    int y = nonzero_pix_bk.first[i].second;

    // Get pix_value from the second vector
    uint16_t pix_value = nonzero_pix_bk.second[i];

    // Set the ith pixel to the x, y cords of the nonzero pixel
    sand_bk->setPosition(i, x, y);
  }
  for (size_t i = 0; i < N_GRAINS2_bk; ++i) {
    // Get x, y values from the first vector
    int x = nonzero_pix2_bk.first[i].first;
    int y = nonzero_pix2_bk.first[i].second;

    // Get pix_value from the second vector
    uint16_t pix_value2_bk = nonzero_pix2_bk.second[i];

    // Set the ith pixel to the x, y cords of the nonzero pixel
    sand2_bk->setPosition(i, x, y);
  }

  Serial.println("Done setting up bk.");
}

// MAIc:\Users\gabri\Documents\MyStuff\Protogen\Programming\Matrix Portal\falling_sand\falling_sand_bk.inoN LOOP - RUNS ONCE PER FRAME OF ANIMATION ----------------------------

void loop_falling_sand_bk() {
  // Limit the animation frame rate to MAX_FPS.  Because the subsequent sand
  // calculations are non-deterministic (don't always take the same amount
  // of time, depending on their current states), this helps ensure that
  // things like gravity appear constant in the simulation.
  uint32_t t;
  while(((t = micros()) - prevTime) < (1000000L / MAX_FPS));
  prevTime = t;

  // Read accelerometer...
  sensors_event_t event;
  accel_bk.getEvent(&event);
  // Serial.printf("(%0.1f, %0.1f, %0.1f)\n", event.acceleration.x, event.acceleration.y, event.acceleration.z);

  double xx, yy, zz;
  xx = event.acceleration.x * 1000;
  yy = event.acceleration.y * 1000;
  zz = event.acceleration.z * 1000;

  // Run one frame of the simulation
  // Screen 1 is normal
  sand_bk->iterate(-xx, yy, zz);
  // Screen 2 is flipped
  sand2_bk->iterate(-xx, yy, zz);

  // Update pixel data in LED driver
  matrix.fillScreen(0x0); // Clear the screen first

  // Iterate over the matrix and update it with the bitmap data
  dimension_t x, y;
  for (int i = 0; i < N_GRAINS_bk; i++) {
    // Get the x and y coordinates of the ith "grain"
    sand_bk->getPosition(i, &x, &y);

    // Get the ith color from the nonzero pixels
    uint16_t pix_value = nonzero_pix_bk.second[i];
    
    // Draw the pixel on the matrix using the color from the bitmap
    matrix.drawPixel(x, y, pix_value);
  }
  for (int i = 0; i < N_GRAINS2_bk; i++) {
    // Get the x and y coordinates of the ith "grain"
    sand2_bk->getPosition(i, &x, &y);

    // Get the ith color from the nonzero pixels
    uint16_t pix_value2 = nonzero_pix2_bk.second[i];
    
    // Draw the pixel on the matrix using the color from the bitmap
    matrix.drawPixel(WIDTH-x-1, y, pix_value2);
  }
  
  matrix.show(); // Copy data to matrix buffers
}
