/* ----------------------------------------------------------------------
"Pixel dust" Protomatter library example. As written, this is
SPECIFICALLY FOR THE ADAFRUIT MATRIXPORTAL with 64x32 pixel matrix.
Change "HEIGHT" below for 64x64 matrix. Could also be adapted to other
Protomatter-capable boards with an attached LIS3DH accelerometer.

PLEASE SEE THE "simple" EXAMPLE FOR AN INTRODUCTORY SKETCH,
or "doublebuffer" for animation basics.
------------------------------------------------------------------------- */

#include <Wire.h>                 // For I2C communication
#include <Adafruit_LIS3DH.h>      // For accelerometer
#include <Adafruit_PixelDust.h>   // For sand simulation
#include <Adafruit_Protomatter.h> // For RGB matrix

#define HEIGHT  32 // Matrix height (pixels) - SET TO 64 FOR 64x64 MATRIX!
#define WIDTH   64 // Matrix width (pixels)
#define MAX_FPS 45 // Maximum redraw rate, frames/second/home/gmongaras/Documents/MyStuff/Protogen/Programming/LCD_Eye_Blink_4/LCD_Eye_Blink_4.ino

#if defined(_VARIANT_MATRIXPORTAL_M4_) // MatrixPortal M4
uint8_t rgbPins[]  = {7, 8, 9, 10, 11, 12};
uint8_t addrPins[] = {17, 18, 19, 20, 21};
uint8_t clockPin   = 14;
uint8_t latchPin   = 15;
uint8_t oePin      = 16;
#else // MatrixPortal ESP32-S3
uint8_t rgbPins[]  = {42, 41, 40, 38, 39, 37};
uint8_t addrPins[] = {45, 36, 48, 35, 21};
uint8_t clockPin   = 2;
uint8_t latchPin   = 47;
uint8_t oePin      = 14;
#endif

#if HEIGHT == 16
#define NUM_ADDR_PINS 3
#elif HEIGHT == 32
#define NUM_ADDR_PINS 4
#elif HEIGHT == 64
#define NUM_ADDR_PINS 5
#endif

Adafruit_Protomatter matrix(
  WIDTH, 4, 1, rgbPins, NUM_ADDR_PINS, addrPins,
  clockPin, latchPin, oePin, true);

Adafruit_LIS3DH accel = Adafruit_LIS3DH();

#define N_COLORS   8
#define BOX_HEIGHT 8
// #define N_GRAINS (BOX_HEIGHT*N_COLORS*8)
uint16_t colors[N_COLORS];

// Pointer to a sand object
Adafruit_PixelDust* sand = nullptr;

// Number of grains in the sand object
int N_GRAINS;

// pair of vectors for all nonzero pixels
std::pair<std::vector<std::pair<int, int>>, std::vector<uint16_t>> nonzero_pix = {
    {},  // Empty vector of pairs<int, int> (coordinates)
    {}   // Empty vector of uint16_t (pixel value)
};

uint32_t prevTime = 0; // Used for frames-per-second throttle

// SETUP - RUNS ONCE AT PROGRAM START --------------------------------------

void err(int x) {
  uint8_t i;
  pinMode(LED_BUILTIN, OUTPUT);       // Using onboard LED
  for(i=1;;i++) {                     // Loop forever...
    digitalWrite(LED_BUILTIN, i & 1); // LED on/off blink to alert user
    delay(x);
  }
}

// Example 64x32 bitmap in RGB565 format (use your own bitmap data here)
// Each entry corresponds to a pixel color in RGB565 format
uint16_t bitmap[32][64] = {
  { 0x0000, 0x0000, 0x0000, 0x0000, 0x0000, 0x0000, 0x0000, 0x0000, 0x0000, 0x0000, 0x0000, 0x0000, 0x0000,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 0x0000, 0x0000 },
  { 0x0000, 0x0000, 0x0000, 0x0000, 0x0000, 0x10A2, 0x5ACB, 0x0000, 0x0000, 0x0000, 0x0000, 0x0000, 0x0000,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 0x0000, 0x0000 },
  { 0x0000, 0x0000, 0x0000, 0x0000, 0x0000, 0x52AA, 0xFFFF, 0x738E, 0x0000, 0x0000, 0x0000, 0x0000, 0x0000,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 0x0000, 0x0000 },
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  { 0x0000, 0x0000, 0x0000, 0x0000, 0x0000, 0x0000, 0x0000, 0x0000, 0x0000, 0x0000, 0x0000, 0x9492, 0xFFFF,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 0x0000, 0x0000 }
};

// Function to initialize the matrix from a bitmap
void initMatrixFromBitmap(uint16_t bitmap[HEIGHT][WIDTH]) {
  // Update the matrix screen with pixels
  for (int y = 0; y < HEIGHT; y++) {
    for (int x = 0; x < WIDTH; x++) {
      // Write the pixel to the matrix
      uint16_t pixval = bitmap[y][x];
      matrix.drawPixel(x, y, pixval);

      // Get all x, y, and pixel values for nonzero pixels in the bitmap
      if ((uint16_t)pixval != (uint16_t)0x000) {
        nonzero_pix.first.push_back(std::make_pair(x, y));
        nonzero_pix.second.push_back(pixval);
      }
    }
  }
  matrix.show(); // Display the bitmap on the matrix
}

void setup(void) {
  Serial.begin(9600);
  
  ProtomatterStatus status = matrix.begin();
  Serial.printf("Protomatter begin() status: %d\n", status);

  // Initialize the matrix with a bitmap and get the nonzero grains
  initMatrixFromBitmap(bitmap);

  // Get number of nonzero grains
  N_GRAINS = nonzero_pix.first.size();

  // other params
  int s = 1; // Accelerometer scaling
  int e = 32; // Particle elasticity/bounce
  // Create the sand object
  sand = new Adafruit_PixelDust(WIDTH, HEIGHT, N_GRAINS, s, e, false);

  // Start sand and accelerometer
  if (!sand->begin()) {
    Serial.println("Couldn't start sand");
    err(1000); // Slow blink = malloc error
  }
  if (!accel.begin(0x19)) {
    Serial.println("Couldn't find accelerometer");
    err(250);  // Fast blink = I2C error
  }
  accel.setRange(LIS3DH_RANGE_8_G);   // 2, 4, 8 or 16 G!

  // Iterate over all grains and set them in the sand object
  for (size_t i = 0; i < N_GRAINS; ++i) {
    // Get x, y values from the first vector
    int x = nonzero_pix.first[i].first;
    int y = nonzero_pix.first[i].second;

    // Get pix_value from the second vector
    uint16_t pix_value = nonzero_pix.second[i];

    // Set the ith pixel to the x, y cords of the nonzero pixel
    sand->setPosition(i, x, y);
  }
}

// MAIc:\Users\gabri\Documents\MyStuff\Protogen\Programming\Matrix Portal\falling_sand\falling_sand_bk.inoN LOOP - RUNS ONCE PER FRAME OF ANIMATION ----------------------------

void loop() {
  // Limit the animation frame rate to MAX_FPS.  Because the subsequent sand
  // calculations are non-deterministic (don't always take the same amount
  // of time, depending on their current states), this helps ensure that
  // things like gravity appear constant in the simulation.
  uint32_t t;
  while(((t = micros()) - prevTime) < (1000000L / MAX_FPS));
  prevTime = t;

  // Read accelerometer...
  sensors_event_t event;
  accel.getEvent(&event);
  //Serial.printf("(%0.1f, %0.1f, %0.1f)\n", event.acceleration.x, event.acceleration.y, event.acceleration.z);

  double xx, yy, zz;
  xx = event.acceleration.x * 1000;
  yy = event.acceleration.y * 1000;
  zz = event.acceleration.z * 1000;

  // Run one frame of the simulation
  sand->iterate(xx, yy, zz);

  // Update pixel data in LED driver
  matrix.fillScreen(0x0); // Clear the screen first

  // Iterate over the matrix and update it with the bitmap data
  dimension_t x, y;
  for (int i = 0; i < N_GRAINS; i++) {
    // Get the x and y coordinates of the ith "grain"
    sand->getPosition(i, &x, &y);

    // Get the ith color from the nonzero pixels
    uint16_t pix_value = nonzero_pix.second[i];
    
    // Draw the pixel on the matrix using the color from the bitmap
    matrix.drawPixel(x, y, pix_value);
  }
  
  matrix.show(); // Copy data to matrix buffers
}
